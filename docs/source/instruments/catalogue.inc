.. container:: qt-instruments

   .. container:: qt-group

      .. rubric:: Network and spectrum analyzers

      - :doc:`Rohde & Schwarz ZNB </instruments/RSZNB>`
      - :doc:`Rohde & Schwarz FSV3030 </instruments/RSFSV>`
      - :doc:`Keysight FieldFox N9916A </instruments/N9916A>`

   .. container:: qt-group

      .. rubric:: RF sources

      - :doc:`Rohde & Schwarz SMA100B </instruments/SMA100B>`
      - :doc:`Valon 5019 </instruments/VALON519>`
      - :doc:`NI QuickSyn </instruments/QUICKSYNTH>`

   .. container:: qt-group

      .. rubric:: DC sources and meters

      - :doc:`Keithley 2231A </instruments/2231A>`
      - :doc:`Keithley 6514 </instruments/6514>`
      - :doc:`SRS SIM928 </instruments/SIM928>`

   .. container:: qt-group

      .. rubric:: Cryostats

      - :doc:`Oxford Instruments Triton </instruments/triton>`
      - :doc:`Oxford Instruments Proteox </instruments/proteox>`

   .. container:: qt-group

      .. rubric:: RF switches and attenuators

      - :doc:`Radiall R591722600 </instruments/R591722600>`
      - :doc:`Kratos 3494-64 </instruments/3494_64>`
      - :ref:`Arduino firmware <arduino_firmware>`

   .. container:: qt-group

      .. rubric:: Digitizers

      - :class:`NI PXIe-5170R <qtics.instruments.ni.pxie5170r.Pxie5170R>`
